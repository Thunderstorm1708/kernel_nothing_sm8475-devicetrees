// SPDX-License-Identifier: BSD-3-Clause
/*
 * Copyright (c) Qualcomm Technologies, Inc. and/or its subsidiaries.
 */

/dts-v1/;

#include "diwali.dtsi"

/ {
	model = "Qualcomm Technologies, Inc. Diwali SoC";
	compatible = "qcom,diwali";
	qcom,board-id = <0 0>;
};
