// SPDX-License-Identifier: BSD-3-Clause
/*
 * Copyright (c) Qualcomm Technologies, Inc. and/or its subsidiaries.
 */

/dts-v1/;

#include "diwalip.dtsi"

/ {
	model = "Qualcomm Technologies, Inc. DiwaliP SoC";
	compatible = "qcom,diwalip";
	qcom,board-id = <0 0>;
};
