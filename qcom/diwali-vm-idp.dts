// SPDX-License-Identifier: BSD-3-Clause
/*
 * Copyright (c) Qualcomm Technologies, Inc. and/or its subsidiaries.
 */

/dts-v1/;

#include "diwali-vm.dtsi"
#include "diwali-vm-idp.dtsi"

/ {
	model = "Qualcomm Technologies, Inc. Diwali SVM IDP";
	compatible = "qcom,diwali-idp", "qcom,diwali", "qcom,idp";
	qcom,board-id = <34 0>, <34 1>, <34 2>, <34 3>;
};
