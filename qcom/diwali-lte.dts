// SPDX-License-Identifier: BSD-3-Clause
/*
 * Copyright (c) Qualcomm Technologies, Inc. and/or its subsidiaries.
 */

/dts-v1/;

#include "diwali-lte.dtsi"

/ {
	model = "Qualcomm Technologies, Inc. Diwali LTE";
	compatible = "qcom,diwali-lte";
	qcom,board-id = <0 0>;
};
