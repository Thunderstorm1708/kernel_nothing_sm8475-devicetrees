// SPDX-License-Identifier: BSD-3-Clause
/*
 * Copyright (c) Qualcomm Technologies, Inc. and/or its subsidiaries.
 */

#include "diwali.dtsi"

/ {
	model = "Qualcomm Technologies, Inc. DiwaliP";
	compatible = "qcom,diwalip";
	qcom,msm-id = <547 0x10000>;
};
