// SPDX-License-Identifier: BSD-3-Clause
/*
 * Copyright (c) Qualcomm Technologies, Inc. and/or its subsidiaries.
 */

#include "diwali.dtsi"

/ {
	model = "Qualcomm Technologies, Inc. Diwali LTE";
	compatible = "qcom,diwali-lte";
	qcom,msm-id = <564 0x10000>;
};
